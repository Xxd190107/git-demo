includes{
    #include"gDiagFuncLib_for_TM.cin"
}

varibles{
    int a;
    float b;
}

testcase TC_aaaaa(){
    a = 5;
    b = 3.14;
}

main {
    int a = 10;
    int b = 20;
    int c = a + b;
    printf("The sum of a and b is: %d\n", c);
}