includes{
    #include"gDiagFuncLib_for_TM.cin"
}

main {
    int a = 10;
    int b = 20;
    int c = a + b;
    printf("The sum of a and b is: %d\n", c);
}